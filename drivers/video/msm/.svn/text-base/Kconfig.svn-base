## drivers/video/msm/.svn/text-base/Kconfig.svn-base
```kconfig
#
# HDMI Configuration
#

config MSM_HDMI
	tristate "MSM HDMI"
	depends on MACH_QSD8X50_SURF_S70
	help
	  MSM/QSD HDMI controller.

config MSM_HDMI_POWER_OFF_WHEN_LP
	bool "Power off when disable HDMI"
	depends on MSM_HDMI
	help
	  Power off when disable HDMI
	  
config MSM_FB_RGB565
	tristate "MSM FB RGB565"
	depends on MACH_QSD8X50_SURF_S7_S7200
	default n
	help
	  MSM/QSD FB controller.
```

## drivers/video/msm/Kconfig
```kconfig
config MSM_FB_RGB565
	tristate "MSM FB RGB565"
	depends on MACH_QSD8X50_SURF_S7_S7200
	default n
	help
	  MSM/QSD FB controller.
```
